## CMakeLists.txt
```
# SPDX-License-Identifier: Apache-2.0

cmake_minimum_required(VERSION 3.20.0)
find_package(Zephyr REQUIRED HINTS $ENV{ZEPHYR_BASE})

project(rigle)

# 添加源文件到 app target
target_sources(app PRIVATE
    src/main.c
    can/stm32_can.c
)
```

## west.yml
```
manifest:
  self:
    path: rigle  #修正拼写错误

  remotes:
    - name: github
      url-base: ssh://git@github.com 
    - name: origin 
      url-base: ssh://git@github.com/zagerx  # 改为 SSH 协议

  defaults:
    remote: origin
    revision: master

  projects:
    - name: zephyr
      remote: github
      repo-path: zephyrproject-rtos/zephyr
      revision: v4.1.0
      import:
        name-allowlist:
          - cmsis
          - cmsis-dsp
          - hal_stm32
          - segger
  
    - name: ProtocolV4
      path: modules/lib/ProtocolV4
      submodules: true
      revision: master

    - name: motorlib
      path: modules/lib/motorlib
      revision: master

    - name: CommonLibrary
      path: modules/lib/CommonLibrary
      revision: master

    - name: syrius-dts
      path: syrius-dts/
      remote: origin  # 改为存在的 remote
      revision: master
    
    - name: syrius-boards
      path: syrius-boards/
      remote: origin  # 改为存在的 remote
      revision: master

    - name: CustomMCUBoot
      path: bootloader/mcuboot
      remote: origin  # 改为存在的 remote
      revision: 346f7374
```

## prj.conf
```kconfig
CONFIG_GPIO=y
CONFIG_LOG=y
CONFIG_COMPILER_SAVE_TEMPS=y
CONFIG_CMSIS_DSP=y
CONFIG_CMSIS_DSP_BASICMATH=y  # 根据需要启用其他功能模块
CONFIG_CMSIS_DSP_CONTROLLER=y  # 启用三角函数函数（包含 arm_sin_cos_f32）
CONFIG_CMSIS_DSP_FASTMATH=y

# 禁用 UART 控制台输出
CONFIG_UART_CONSOLE=n

# 启用 RTT 控制台
CONFIG_RTT_CONSOLE=y

# 启用 SEGGER RTT 通信协议
CONFIG_SEGGER_SYSTEMVIEW=y
CONFIG_USE_SEGGER_RTT=y

CONFIG_FPU=y
CONFIG_FPU_SHARING=y

CONFIG_CAN=y
CONFIG_CAN_FD_MODE=y
CONFIG_CAN_STM32_FDCAN=y
CONFIG_CAN_INIT_PRIORITY=70
```

## src/main.c
```c
/*
 * Copyright (c) 2016 Intel Corporation
 *
 * SPDX-License-Identifier: Apache-2.0
 */

#include <zephyr/kernel.h>
#include <zephyr/drivers/gpio.h>

/* 1000 msec = 1 sec */
#define SLEEP_TIME_MS 1
#define LED0_NODE     DT_ALIAS(led0)
const struct gpio_dt_spec led = GPIO_DT_SPEC_GET(LED0_NODE, gpios);
extern int can_init(void);

int main(void)
{
	can_init();
	gpio_pin_configure_dt(&led, GPIO_OUTPUT_ACTIVE);
	while (1) {
		gpio_pin_toggle_dt(&led);
		k_msleep(300);
	}
	return 0;
}
```
